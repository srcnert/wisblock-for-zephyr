## app/ai/neuton/sample.yaml
```yaml
sample:
  name: Neuton-AI
tests:
  sample.neuton_ai:
    platform_allow:
      - rak3362/nrf54l15/cpuapp
      - rak4631
      - rak11720
    tags: rak
    build_only: true
```

## app/basic/dfu/sample.yaml
```yaml
sample:
  name: DFU
tests:
  sample.basic.dfu.uart:
    platform_allow:
      - rak3172
      - rak11160
    extra_args: EXTRA_CONF_FILE=overlay_mcuboot.conf
    sysbuild: true
    tags: rak
    build_only: true
  sample.basic.dfu.ble:
    platform_allow:
      - rak3112/esp32s3/procpu
      - rak3362/nrf54l15/cpuapp
      - rak4631
      - rak5010
      - rak11720
    extra_args: EXTRA_CONF_FILE=overlay_ble.conf;overlay_mcuboot.conf
    sysbuild: true
    tags: rak
    build_only: true
```

## app/basic/dfu/sysbuild/mcuboot/boards/rak3362_cpuapp.conf
```kconfig
# Use RTT logging to debug mcuboot application!!!
CONFIG_USE_SEGGER_RTT=y
CONFIG_LOG_BACKEND_RTT=y
CONFIG_LOG_BACKEND_UART=n

CONFIG_MULTITHREADING=y
```

## app/basic/uart_sleep/sample.yaml
```yaml
sample:
  name: UART Sleep
tests:
  sample.basic.uart_sleep:
    platform_allow:
      - rak3172
      - rak3362/nrf54l15/cpuapp
      - rak4631
      - rak11160
    tags: rak
    build_only: true
  sample.basic.uart_sleep.ble:
    platform_allow:
      - rak11720
    extra_args: EXTRA_CONF_FILE=overlay_ble.conf
    tags: rak
    build_only: true
```

## app/lora/lora_shell/sample.yaml
```yaml
sample:
  name: LoRa Shell
tests:
  sample.lora.lora_shell:
    platform_allow:
      - rak3112/esp32s3/procpu
      - rak3172
      - rak3362/nrf54l15/cpuapp
      - rak4631
      - rak11160
      - rak11720
    tags: rak
    build_only: true
```

## app/lora/lora_test/sample.yaml
```yaml
sample:
  name: Power Test
tests:
  sample.lora.lora_test.rak3112:
    platform_allow:
      - rak3112/esp32s3/procpu
    tags: rak
    build_only: true
  sample.lora.lora_test.rak3172:
    platform_allow:
      - rak3172
      - rak11160
    extra_args: EXTRA_CONF_FILE=overlay_sleep_rak3172.conf
    tags: rak
    build_only: true
  sample.lora.lora_test.rak4631:
    platform_allow:
      - rak4631
    extra_args: EXTRA_CONF_FILE=overlay_sleep_rak4631.conf
    tags: rak
    build_only: true
  sample.lora.lora_test.rak11720:
    platform_allow:
      - rak11720
    extra_args: EXTRA_CONF_FILE=overlay_sleep_rak11720.conf
    tags: rak
    build_only: true
```

## app/lora/sleep_test/sample.yaml
```yaml
sample:
  name: LoRa Sleep Test
tests:
  sample.lora.sleep_test.rak3112:
    platform_allow:
      - rak3112/esp32s3/procpu
    sysbuild: true
    tags: rak
    build_only: true
  sample.lora.sleep_test.rak3172:
    platform_allow:
      - rak3172
      - rak11160
    extra_args: EXTRA_CONF_FILE=overlay_sleep_rak3172.conf
    tags: rak
    build_only: true
  sample.lora.sleep_test.rak3362:
    platform_allow:
      - rak3362/nrf54l15/cpuapp
    extra_args: EXTRA_CONF_FILE=overlay_ble.conf;overlay_sleep_rak3362.conf
    tags: rak
    build_only: true
  sample.lora.sleep_test.rak4631:
    platform_allow:
      - rak4631
    extra_args: EXTRA_CONF_FILE=overlay_ble.conf;overlay_sleep_rak4631.conf
    tags: rak
    build_only: true
  sample.lora.sleep_test.rak11720:
    platform_allow:
      - rak11720
    extra_args: EXTRA_CONF_FILE=overlay_ble.conf;overlay_sleep_rak11720.conf
    tags: rak
    build_only: true
```

## boards/rakwireless/rak3362/Kconfig.defconfig
```kconfig
# Copyright (c) 2026 RAK Wireless
# SPDX-License-Identifier: Apache-2.0

if BOARD_RAK3362_NRF54L15_CPUAPP

config HAS_BT_CTLR
	default BT

config ROM_START_OFFSET
	default 0x800 if BOOTLOADER_MCUBOOT

endif # BOARD_RAK3362_NRF54L15_CPUAPP

if BOARD_RAK3362

config WISBLOCK_CORE_BOARD_VENDOR
	string
	default "RAKwireless"

config WISBLOCK_CORE_BOARD_NAME
	string
	default "RAK3362 WisBlock Core Module"

endif # BOARD_RAK3362
```

## boards/rakwireless/rak3362/Kconfig.rak3362
```kconfig
# Copyright (c) 2026 RAK Wireless
# SPDX-License-Identifier: Apache-2.0

config BOARD_RAK3362
	select SOC_NRF54L15_CPUAPP if BOARD_RAK3362_NRF54L15_CPUAPP
```

## west.yml
```yaml
# SPDX-License-Identifier: Apache-2.0

manifest:
  self:
    path: wisblock-for-zephyr
    west-commands: scripts/west-commands.yml

  remotes:
    - name: ncs
      url-base: https://github.com/nrfconnect

  projects:
    - name: nrf
      repo-path: sdk-nrf
      remote: ncs
      revision: v3.3.0
      import: true
```
